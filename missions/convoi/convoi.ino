#include <SPI.h>
#include <Gamebuino.h>
Gamebuino gb;

const byte FinalScreen[] PROGMEM = {88,48,0x0,0x0,0x0,0x0,0x0,0x0,0x0,0x0,0x0,0x0,0x0,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0xC0,};
const byte loading[] PROGMEM = {88,48,0x0,0x0,0xD,0xF8,0x0,0x0,0xDD,0xD4,0x0,0x0,0x0,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0x0,};


const byte ex1[] PROGMEM = {32,32,0x0,0x0,0x0,0x0,0x0,0x0,0x0,0x0,0x0,0x0,0x0,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0xBC,};
const byte ex2[] PROGMEM = {32,32,0x0,0x0,0x0,0x0,0x0,0x0,0x0,0x0,0x0,0x0,0x0,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0xDC,};
const byte ex3[] PROGMEM = {32,32,0x0,0x0,0x0,0x0,0x0,0x0,0x0,0x0,0x0,0x0,0x0,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0xDC,};
const byte ex4[] PROGMEM = {32,32,0x0,0x0,0x0,0x0,0x0,0x0,0x0,0x0,0x0,0x0,0x0,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0x7C,};
const byte ex5[] PROGMEM = {32,32,0x0,0x0,0x0,0x0,0x0,0x0,0x0,0x0,0x0,0x11,0x1,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0xFC,};
const byte ex6[] PROGMEM = {32,32,0xFF,0xFF,0xFF,0xFC,0xFF,0xFF,0xFF,0xFC,0xFF,0xF9,0xFF,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0xBC,};
const byte ex7[] PROGMEM = {32,32,0x0,0x0,0x0,0x0,0x0,0x0,0x0,0x0,0x7,0x96,0x7E,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0xDC,};



const byte camionB[] PROGMEM = {16,14,0x7,0xE0,0xA,0x50,0xE,0x70,0x4,0x20,0x4,0x20,0x4,0x20,0x7,0xE0,0x7,0xE0,0x7,0xE0,0x4,0x20,0x7,0xE0,0xF,0xF0,0xB,0xD0,0x7,0xE0,};
const byte camionBD[] PROGMEM = {16,15,0xC,0x0,0xF,0x0,0x1F,0xC0,0x27,0xF0,0xE3,0xF8,0xF0,0xCE,0xFC,0x9B,0xFF,0xF1,0xBF,0x23,0x9F,0xEF,0x7F,0xF9,0x1F,0xE3,0x7,0x7E,0x1,0x3C,0x0,0xF0,};
const byte camionBG[] PROGMEM = {16,15,0x0,0x30,0x0,0xF0,0x3,0xFD,0xF,0xE3,0x1F,0xCF,0x73,0x1F,0xD9,0xBF,0x8F,0xFF,0xC4,0xFD,0xF7,0xF9,0x9F,0xFE,0xC7,0xF8,0x7E,0xE0,0x3C,0x80,0xF,0x0,};
const byte camionD[] PROGMEM = {16,14,0x0,0x0,0x0,0x0,0x0,0x0,0x0,0x0,0x0,0x70,0xFF,0xC8,0xFF,0xC8,0xFF,0xFC,0xFF,0xFF,0xFF,0xFE,0xFF,0xFF,0x50,0x28,0x20,0x10,0x0,0x0,};
const byte camionG[] PROGMEM = {16,14,0x0,0x0,0x0,0x0,0x0,0x0,0x0,0x0,0xE,0x0,0x13,0xFF,0x13,0xFF,0x3F,0xFF,0xFF,0xFF,0x7F,0xFF,0xFF,0xFF,0x14,0xA,0x8,0x4,0x0,0x0,};
const byte camionH[] PROGMEM = {16,14,0x0,0x0,0x7,0xE0,0x7,0xE0,0x7,0xE0,0x4,0x20,0xF,0xF0,0xC,0x30,0xC,0x30,0xC,0x30,0xC,0x30,0xC,0x30,0xB,0xD0,0x7,0xE0,0x2,0x40,};
const byte camionHD[] PROGMEM = {16,14,0x0,0xF0,0x1,0xFC,0x3,0x7E,0xF,0x3A,0x1F,0x97,0x7E,0x7F,0x58,0x7E,0xD1,0xFC,0xE7,0xF8,0xCB,0xE8,0xEB,0xB0,0x7F,0x80,0x1D,0x0,0xE,0x0,};
const byte camionHG[] PROGMEM = {16,14,0xF,0x0,0x3F,0x80,0x7E,0xC0,0x5C,0xF0,0xE9,0xF8,0xFE,0x7E,0x7E,0x1A,0x3F,0x8B,0x1F,0xE7,0x17,0xD3,0xD,0xD7,0x1,0xFE,0x0,0xB8,0x0,0x70,};

const byte mecaB[] PROGMEM = {16,22,0x0,0x0,0x0,0x0,0xF0,0xF,0x90,0x9,0xD0,0xD,0xB3,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0x79,};
const byte mecaBD[] PROGMEM = {16,22,0x0,0x70,0x0,0xCC,0x0,0xE3,0x0,0x9F,0x70,0x85,0xDF,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0x80,};
const byte mecaBG[] PROGMEM = {16,22,0xE,0x0,0x33,0x0,0xC7,0x0,0xF9,0x0,0xA1,0xE,0xA3,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0xC0,};
const byte mecaD[] PROGMEM = {16,22,0x0,0x0,0x0,0x0,0x1F,0xE0,0x10,0x20,0x10,0x40,0x10,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0x9C,};
const byte mecaG[] PROGMEM = {16,22,0x0,0x0,0x0,0x0,0x7,0xF8,0x4,0x8,0x2,0x8,0x4,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0xFB,};
const byte mecaH[] PROGMEM = {16,22,0x0,0x0,0x0,0x0,0xF0,0xF,0x90,0x9,0xB0,0xD,0xF3,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0x79,};
const byte mecaHD[] PROGMEM = {16,22,0xE,0x0,0x33,0x0,0xC7,0x0,0xF9,0x0,0xA1,0xE,0xE3,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0x0,};
const byte mecaHG[] PROGMEM = {16,22,0x0,0x70,0x0,0xCC,0x0,0xE3,0x0,0x9F,0x70,0x85,0xDF,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0x0,};

const byte roudeH[] PROGMEM = {16,16,0xF7,0xD9,0x9E,0xFF,0x0,0x0,0x0,0x0,0x0,0x0,0x0,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0x6F,};
const byte roudeV[] PROGMEM = {16,16,0xC0,0x3,0xC1,0x41,0x84,0x1,0x80,0x43,0xC1,0x2,0x40,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0x3,};
const byte virage1[] PROGMEM = {16,16,0xEE,0x4,0xFF,0x80,0x7,0xA0,0x1,0xE2,0x0,0x78,0x0,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0x3,};
const byte virage2[] PROGMEM = {16,16,0x20,0x77,0x1,0xFF,0x5,0xE0,0x47,0x80,0x1E,0x0,0x3C,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0x83,};
const byte virage3[] PROGMEM = {16,16,0xC1,0x3,0xC0,0x83,0x1,0x43,0x0,0x3,0x5,0x7,0x0,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0x4,};
const byte virage4[] PROGMEM = {16,16,0xC0,0x83,0xC1,0x3,0xC2,0x80,0xC3,0x0,0xE2,0xA0,0x60,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0x77,};
const byte routeExplose[] PROGMEM = {16,16,0xF7,0xD9,0x98,0x37,0x9,0x48,0x19,0x46,0x21,0x22,0x42,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0x6F,};







#define NAME_MENU "CS"

#define GAME 2

#define SCREENWIDTH 84
#define SCREENHEIGHT 48
#define VERTALIGNMENT 10
#define LEVELWIDTH 630
#define LEVELHEIGHT 630
#define SPRITESIZE 125

#define MAXALTITUDE 8
#define MAXFUEL 30
#define MAXLIFE 50
#define MAXBULLET 10

#define TMPUNIT 20
#define TMPTANK 40
#define TMPTOUR 20
#define TMPBUNKER 10
#define TMPRESURECTION 200
#define WAIT_TIME 240

extern const byte HUD[];

extern const byte helix[4][8];
extern const byte impact[3][10];
extern const byte boom[12][13];


extern const byte copterShadow[];
extern const byte copterProfile[];
extern const byte copterProfile_mask[];
extern const byte copterDiag1[];
extern const byte copterDiag1_mask[];
extern const byte copterDiag2[];
extern const byte copterDiag2_mask[];
extern const byte copterDown[];
extern const byte copterUp[];
extern const byte copterUpDown_mask[];

extern const byte Ennemy_Unit[];

extern const byte* sprites[];
extern const byte* destroy[];
extern const byte* tank[];
extern const byte* spriteBkg[];

//Struct
typedef struct{
  int  x_world;
  int  y_world;
  char dir;
  char vSpeed;
  char hSpeed;
  byte altitude;
  byte isLanding;
  byte fire;
  byte fuel;
  byte fuelCheck;
  byte life;
  byte isCrashing;
  byte animHelix;
  byte animBoom;
  byte animDamage;
  byte moveMode;
} Player;

typedef struct{
  byte shooter;
  int x_world;
  int y_world;
  byte dir;
  byte distance;
} Bullet;

typedef struct{
  int x_world;
  int y_world;
  byte width;
  byte height;
  byte sprite;
  byte life; 
  byte animBoom;
  byte fireTimer;
} Hostile;

typedef struct{
  int x_world;
  int y_world;
  byte width;
  byte height;
  byte sprite;
  byte life; 
  byte animBoom;
  byte fireTimer;
  byte dir;
  byte batiment;
} HostileMobile;

typedef struct{
  int x_world;
  int y_world;
  byte width;
  byte height;
  byte sprite;
  byte life; 
  byte animBoom;
} Object;

typedef struct{
  int x_world;
  int y_world;
  byte width;
  byte height;
  byte sprite;
} Friend;

typedef struct{
  int x_world;
  int y_world;
  byte sprite;
} Bkgrnd;


typedef struct{
  uint16_t  x_world;
  uint16_t  y_world;
  byte sprite;
} route;

#define MAX_LIFE_CAM 250
typedef struct{
  int x_world;
  int y_world;
  byte width;
  byte height;
  const byte * sprites[8] = {camionD,camionHD,camionBD,camionG,camionHG,camionBG,camionH,camionB};
  byte life; 
  byte animBoom;
  byte dir;
  byte animDamage;
} friendMobile;

friendMobile Camion;

typedef struct{
  uint16_t  x_world;
  uint16_t  y_world;
} checkPoint;

//18
#define NB_CHECK_POINT 19
const checkPoint CheckPoint[NB_CHECK_POINT] PROGMEM = {
  {160,56},
  {161,25},
  {249,25},
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  {30,543}//fin
};

uint8_t currentCheckPoint = 0;

//68
#define NB_TSPRITE_ROUTE 68 

const route Routes[NB_TSPRITE_ROUTE] PROGMEM = {
  {112,56,0},
  {128,56,0},
  {144,56,0},
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  {64,536,4},
};

Player        player;
Friend        bkgrnd[15];
Bkgrnd        bkg[19];
Object        building_friend[9];
Hostile       building_hostile[21];
HostileMobile mobilUnit_hostile[20];
Bullet        bullet[MAXBULLET];

#define NB_FRAME_EXPLOSION 7
#define TEMP_EXPOLOSION 35
byte cptExplosion = 0;
const byte * explosion[NB_FRAME_EXPLOSION] = {ex1,ex2,ex3,ex4,ex5,ex6,ex7};

//Global Variables
byte i;
byte j;
byte check01;
byte check02;
byte cptAnim;
byte gameStatus;
//byte lvl;
//byte difficulty;
int money;
byte destroyedBuildings;
int coordx;
int coordy;
byte width;
byte height;
byte nbHeliport;
byte nbBuilding_Hostile;
byte nbBuilding_Friend;
boolean convoiSecuriser = false;
byte wait_time;


//global methode
uint8_t getNext();


//#####################################################
//#####################################################
void setup() {
  gb.begin();
  intialiseMap();
}
void intialiseMap()
{
  gameStatus = GAME;
  money=0;
  cptAnim=0;
  gb.battery.show=false;
  fnctn_initLevel();
  fnctn_initPlayer(); 
  initFriendMobile();
}


//#####################################################
//#####################################################
void loop() {
  if(gb.update()){ 
    
      if(gb.buttons.pressed(BTN_C)){
        returnToMenu();
      }

      //draw baseCamps          (Base, fuel, garage, heliport)
      outpt_drawbaseCamps();
      
      //draw friendBuildings  (Village, Camps) 
      outpt_drawBuilding_Friend();
      //draw hostileBuildings (Tour, Bunker) & Mobiles(Units, Tank)
      outpt_drawBuilding_Hostile();
      outpt_drawMobile_Hostile();

      outpt_draw_route();
      //draw background         (tree, bush, sand, rocks)
      outpt_drawBackground();
      
      //draw player & ennemy Fire
      outpt_drawPlayerFire();
      outpt_drawEnnemyFire();
      
      //draw HUD + Player
      outpt_drawHUD();
      outpt_drawPlayer();
      
      //
      updateFriendMobile();
      outpt_draw_camion();
      
      //draw animBoom
      outpt_animBoom();

      //outpt_GameOver
      outpt_GameOver();

      
      //checks
      fnctn_checkLanding();
      fnctn_checkButtons();
      fnctn_checkPlayerAltitude();
      fnctn_checkPlayerFire();
      fnctn_checkEnnemyFire();
      fnctn_checkFuel();
  
      //Timers
      fnctn_initEnnemyFire();
      fnctn_animation();
      //fnctn_resurection();
  }
}


void endGameOK(){
  while(true){
    if(gb.update()){
     gb.display.drawBitmap(0,0,FinalScreen);
     
      if(gb.buttons.pressed(BTN_C)){
        intialiseMap();
        return;  
      }
      if(gb.buttons.pressed(BTN_A) || gb.buttons.pressed(BTN_B)){
        gb.display.clear();
        gb.display.drawBitmap(0,0,loading);
        gb.display.update();
        load_game(NAME_MENU);
      }
    }
  }
}

void returnToMenu()
{
  while(true){
    if(gb.update()){
      gb.display.println("Are you sur to return "); 
      gb.display.println("To Game menu?");
      gb.display.println("Press \25 to quit");
      gb.display.println("Press \27 to restart");
      
      if(gb.buttons.pressed(BTN_C)){
        intialiseMap();
        return;  
      }
      if(gb.buttons.pressed(BTN_A)){
        gb.display.clear();
        gb.display.println("Extraction ...");
        gb.display.println("Please Wait"); 
        gb.display.update();
        load_game(NAME_MENU);
      }
      if(gb.buttons.pressed(BTN_B)){
        break;
      }
    }
  }
}
